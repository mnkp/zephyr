## boards/arm/tradfri_e1524/Kconfig
```kconfig
# TRADFRI E1524 board configuration

# Copyright (c) 2020 Markus Becker
# SPDX-License-Identifier: Apache-2.0

config BOARD_INIT_PRIORITY
	int
	default KERNEL_INIT_PRIORITY_DEFAULT
	depends on BOARD_EFR32MG_E1524
	help
	  Board initialization priority. This must be bigger than
	  GPIO_GECKO_COMMON_INIT_PRIORITY.
```

## boards/arm/tradfri_e1524/Kconfig.board
```kconfig
# TRADFRI E1524 board

# Copyright (c) 2020, Markus Becker
# SPDX-License-Identifier: Apache-2.0

config BOARD_EFR32MG_E1524
	bool "Ikea Tradfri E1524 (5 button remote)"
	depends on SOC_SERIES_EFR32MG1P
	select SOC_PART_NUMBER_EFR32MG1P132F256GM32
```

## boards/arm/tradfri_e1524/Kconfig.defconfig
```kconfig
# TRADFRI E1524 board

# Copyright (c) 2020, Markus Becker
# SPDX-License-Identifier: Apache-2.0

if BOARD_EFR32MG_E1524

config BOARD
	default "efr32mg_e1524"

config CMU_HFXO_FREQ
	default 40000000

config CMU_LFXO_FREQ
	default 32768

config COUNTER_GECKO_RTCC
	default y
	depends on COUNTER

endif # BOARD_EFR32MG_E1524
```

## drivers/audio/Kconfig.adau1772
```kconfig
# Kconfig - ADAU1772 Audio Processor configuration options
#
# Copyright (c) 2021 Piotr Mienkowski
# SPDX-License-Identifier: Apache-2.0
#

config AUDIO_ADAU1772
	bool "ADAU1772 Audio Processor"
	default n
	help
	  Enable support for ADAU1772 Audio Processor. The ADAU1772 is a codec
	  with four inputs and two outputs that incorporates a digital
	  processing engine to perform filtering, level control, signal level
	  monitoring, and mixing.
```

## drivers/sensor/qdec_sam/Kconfig
```kconfig
# Atmel SAM MCU family Quadrature Decoder (TC) driver configuration options
#
# Copyright (c) 2017 comsuisse AG
# SPDX-License-Identifier: Apache-2.0
#

menuconfig QDEC_SAM
	bool "Atmel SAM QDEC driver"
	depends on SOC_FAMILY_SAM
	default n
	help
	  Atmel SAM MCU family Quadrature Decoder (TC) driver.

# ---------- QDEC_0 ----------

config QDEC_0_SAM
	bool "Enable QDEC_0"
	depends on QDEC_SAM
	default n
	help
	  Configure QDEC_0 at boot depending on the additional options below.

config QDEC_0_SAM_NAME
	string "Device name"
	depends on QDEC_0_SAM
	default "QDEC_0"
	help
	  Device name allows user to obtain a handle to the device object
	  required by all driver API functions. Device name has to be unique.

# ---------- QDEC_1 ----------

config QDEC_1_SAM
	bool "Enable QDEC_1"
	depends on QDEC_SAM
	default n
	help
	  Configure QDEC_1 at boot depending on the additional options below.

config QDEC_1_SAM_NAME
	string "Device name"
	depends on QDEC_1_SAM
	default "QDEC_1"
	help
	  Device name allows user to obtain a handle to the device object
	  required by all driver API functions. Device name has to be unique.

# ---------- QDEC_2 ----------

config QDEC_2_SAM
	bool "Enable QDEC_2"
	depends on QDEC_SAM
	default n
	help
	  Configure QDEC_2 at boot depending on the additional options below.

config QDEC_2_SAM_NAME
	string "Device name"
	depends on QDEC_2_SAM
	default "QDEC_2"
	help
	  Device name allows user to obtain a handle to the device object
	  required by all driver API functions. Device name has to be unique.

# ---------- QDEC_3 ----------

config QDEC_3_SAM
	bool "Enable QDEC_3"
	depends on QDEC_SAM
	default n
	help
	  Configure QDEC_3 at boot depending on the additional options below.

config QDEC_3_SAM_NAME
	string "Device name"
	depends on QDEC_3_SAM
	default "QDEC_3"
	help
	  Device name allows user to obtain a handle to the device object
	  required by all driver API functions. Device name has to be unique.
```

## dts/bindings/audio/adi,adau1772.yaml
```yaml
# Copyright (c) 2021, Piotr Mienkowski
# SPDX-License-Identifier: Apache-2.0

description: Analog Devices ADAU1772

compatible: "adi,adau1772"

include: i2c-device.yaml

properties:
    reg:
      required: true
      description: |
        Device address on i2c bus. Value depends on the state of ADDR0 and
        ADDR1, as wired in hardware.

    pd-gpios:
      type: phandle-array
      required: false
      description: Power Down pin

    input-channels:
      type: string
      required: false
      enum:
       - "0-1"
       - "2-3"
       - "4-5"
       - "6-7"
      description: |
        Selects serial input port channels that contain device data. The value
        is used to configure Input ASRC Channel Select Register.
```

## soc/arm/silabs_exx32/efr32mg12p/Kconfig.defconfig.efr32mg12p
```kconfig
# Silicon Labs EFR32MG12P platform configuration options

# Copyright (c) 2018 Diego Sueiro
# SPDX-License-Identifier: Apache-2.0

config GPIO_GECKO
	default y
	depends on GPIO

if SERIAL

config UART_GECKO
	default y

config LEUART_GECKO
	default y

endif # SERIAL

config I2C_GECKO
	default y
	depends on I2C

config SOC_FLASH_GECKO
	default y
	depends on FLASH

config SPI_GECKO
	default y
	depends on SPI

if NETWORKING

if !NET_L2_OPENTHREAD

config NET_L2_IEEE802154
	default y

endif # NET_L2_OPENTHREAD

config IEEE802154_EFR
	default y

config NET_CONFIG_IEEE802154_DEV_NAME
	default IEEE802154_EFR_DRV_NAME

endif # NETWORKING
```

## soc/arm/silabs_exx32/efr32mg1p/Kconfig.defconfig.series
```kconfig
# EFM32WG series configuration options

# Copyright (c) 2018 Diego Sueiro
# SPDX-License-Identifier: Apache-2.0

if SOC_SERIES_EFR32MG1P

config SOC_SERIES
	default "efr32mg1p"

config SOC_PART_NUMBER
	default "EFR32MG1P132F256GM32" if SOC_PART_NUMBER_EFR32MG1P132F256GM32

config NUM_IRQS
	# must be >= the highest interrupt number used
	default 49

source "soc/arm/silabs_exx32/efr32mg1p/Kconfig.defconfig.efr32mg1p"

endif # SOC_SERIES_EFR32MG12P
```

## soc/arm/silabs_exx32/efr32mg1p/Kconfig.soc
```kconfig
# EFR32MG12P (Mighty Gecko) MCU line

# Copyright (c) 2018 Diego Sueiro
# SPDX-License-Identifier: Apache-2.0

config SOC_PART_NUMBER_EFR32MG1P132F256GM32
	bool
	depends on SOC_SERIES_EFR32MG1P
```
